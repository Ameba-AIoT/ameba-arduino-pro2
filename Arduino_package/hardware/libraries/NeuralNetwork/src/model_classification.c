//------------------------------------------------------
// Image Classification Example
//------------------------------------------------------
#include <math.h>
#include <stdint.h>
#include <stdlib.h>
#include <stdio.h>
#include <string.h>
#include "sys_api.h"
#include "mmf2_module.h"
#include "module_vipnn.h"
#include "hal_cache.h"
#include "img_process/img_process.h"

unsigned char golden_data_bin[] = {
    0x97,
    0x96,
    0x93,
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    0xb8,
};
unsigned int golden_data_bin_len = 2304;


// see amebapro2_fwfs_nn_models.json
static void *classification_get_network_filename(void)
{
    return (void *)"NN_MDL/img_class.nb";    // fix name for NN model binary
}

static void img_rgb2gray(img_t *img)
{
    // planar rgb to gray
    uint8_t *r = img->data;
    uint8_t *g = img->data + img->width * img->height;
    uint8_t *b = img->data + img->width * img->height * 2;
    uint8_t *gray = img->data;

    for (int i = 0; i < img->width * img->height; i++) {
        gray[i] = (r[i] * 19595 + g[i] * 38469 + b[i] * 7472) >> 16;
    }
}

static int classification_preprocess(void *data_in, nn_data_param_t *data_param, void *tensor_in, nn_tensor_param_t *tensor_param)
{
    void **tensor = (void **)tensor_in;
    uint8_t *rgb_data = (uint8_t *)data_in;

    uint8_t *tensor_in_ptr = (uint8_t *)tensor[0];
    int tensor_in_size = tensor_param->dim[0].size[0] * tensor_param->dim[0].size[1] * tensor_param->dim[0].size[2];

    // printf("tensor_in_size = %d\r\n", tensor_in_size);

    img_t img_in, img_out;
    img_in.width = data_param->img.width;
    img_in.height = data_param->img.height;
    img_in.data = rgb_data;    // rgb_data comes from sensor

    img_out.width = tensor_param->dim[0].size[0];
    img_out.height = tensor_param->dim[0].size[1];
    img_out.data = tensor_in_ptr;    // process rgb_data and save result to img_out

    rect_t *roi = &data_param->img.roi;

    // printf("resize (%d,%d) -> (%d,%d), roi:([%d,%d],[%d,%d])\r\n",
    //     img_in.width, img_in.height,
    //     img_out.width, img_out.height,
    //     roi->xmin, roi->ymin, roi->xmax, roi->ymax);

    // resize rgb data to fit input tensor of NN model
    img_resize_planar(&img_in, roi, &img_out);

    // debug: make sure resize is correct
    //  static int dbg_count = 0;
    //  if (dbg_count++ == 10) {
    //      //debug
    //      FILE *f = fopen("img_in.rgb", "wb");
    //      fwrite(img_in.data, 1, img_in.width * img_in.height * 3, f);
    //      fclose(f);

    //     f = fopen("img_out.rgb", "wb");
    //     fwrite(img_out.data, 1, img_out.width * img_out.height * 3, f);
    //     fclose(f);
    // }

    // convert rgb to gray for fer2013_cnn only
    img_rgb2gray(&img_out);

    // debug: test with golden rgb data to make sure model is loaded and quantized correctly
    // memcpy(tensor_in_ptr, golden_data_bin, golden_data_bin_len);

    // debug: make sure rgb2gray is correct
    //  if (dbg_count == 10) {
    //      FILE *f = fopen("img_out.gray", "wb");
    //      fwrite(tensor_in_ptr, 1, tensor_in_size, f);
    //      fclose(f);
    //  }

    dcache_clean_by_addr((uint32_t *)tensor_in_ptr, tensor_in_size);
    return 0;
}

typedef struct data_format_s {
    nn_tensor_format_t *format;
    nn_tensor_dim_t *dim;
} data_format_t;

static int prob_comparator(const void *pa, const void *pb)
{
    classification_res_t *a = (classification_res_t *)pa;
    classification_res_t *b = (classification_res_t *)pb;
    float diff = a->prob - b->prob;
    if (diff < 0) {
        return 1;
    } else if (diff > 0) {
        return -1;
    }
    return 0;
}

classification_res_t *class_ret = NULL;
static int classification_postprocess(void *tensor_out, nn_tensor_param_t *param, void *res)
{
    void **tensor = (void **)tensor_out;
    __fp16 *tensor_out_ptr = (__fp16 *)tensor[0];

    data_format_t fmt;
    fmt.format = &param->format[0];
    fmt.dim = &param->dim[0];
    int class_cnt = fmt.dim->size[0];
    printf("class_cnt = %d\r\n", class_cnt);

    if (class_ret == NULL) {
        class_ret = malloc(class_cnt * sizeof(classification_res_t));
        if (!class_ret) {
            printf("postprocess : out of resource\n\r");
            return 0;
        }
        memset(class_ret, 0, class_cnt * sizeof(classification_res_t));
    }

    for (int i = 0; i < class_cnt; i++) {
        class_ret[i].prob = (float)tensor_out_ptr[i];
        class_ret[i].class_id = i;
    }

    qsort(class_ret, class_cnt, sizeof(classification_res_t), prob_comparator);

    classification_res_t *class_res = (classification_res_t *)res;
    if (class_res == NULL) {
        printf("postprocess : out of resource\n\r");
        return 0;
    }

    for (int i = 0; i < class_cnt; i++) {
        printf("class %d, prob %0.2f\n\r", class_ret[i].class_id, class_ret[i].prob);
        class_res[i] = class_ret[i];    // copy data to class_res for nn_set_object()
    }

    return class_cnt;
}


nnmodel_t img_classification = {
    .nb = classification_get_network_filename,
    .preprocess = classification_preprocess,
    .postprocess = classification_postprocess,
    .model_src = MODEL_SRC_FILE,

    .name = "Image Classification",
};
